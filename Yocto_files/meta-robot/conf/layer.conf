## Yocto_files/meta-robot/conf/layer.conf
```bitbake
BBPATH .= ":${LAYERDIR}"

BBFILES += "${LAYERDIR}/recipes-*/*/*.bb \
            ${LAYERDIR}/recipes-*/*/*.bbappend"

BBFILE_COLLECTIONS += "meta-robot"
BBFILE_PATTERN_meta-robot = "^${LAYERDIR}/"
BBFILE_PRIORITY_meta-robot = "10"
LAYERSERIES_COMPAT_meta-robot = "scarthgap"
```
